// main.c — CHIP-8 for NucleoOS: a CHIP-8 / SUPER-CHIP / XO-CHIP interpreter (chip8.c) with the
// games of the CHIP-8 Community Archive (CC0) built in (games.h, generated by gen_games.py).
//
// Screens: a paged menu of the bundled games (tap one to play), and the game screen: the display
// scaled 12x (64x32) or 6x (128x64) in the game's own Octo palette, a 4x4 hex keypad on the right
// (multi-touch; the keys the game uses are highlighted), the how-to text below, and MENU / RESET /
// speed buttons. Back gesture: game -> menu, menu -> close the app.
// Rendering: ABI v6 persist mode. The static UI is drawn once; each frame only the display rows
// that changed are scaled into a small RGB565 band buffer and blitted, and a keypad key is
// repainted only when its state changes, so an idle game costs almost no host calls.
// Input: touch keypad, gamepads / USB keyboard (nv_gfx_pad, D-pad + A/B/X/Y mapped per game to
// the keys it uses) and the left stick of the first controller (ABI v11).
// Sound: the XO-CHIP audio pattern and pitch played through the ABI v10 PCM stream while the
// sound timer runs (plain CHIP-8 games get a square wave); nv_gfx_tone if the speaker is busy.
#include "nucleo_sdk.h"
#include "chip8.h"

typedef struct {
    const char *id, *title, *author, *info;
    uint32_t off, len;
    uint8_t  platform;
    uint16_t rot, tickrate, quirks, keys;
    uint8_t  start;
    uint16_t col[6];     // background, fill, fill2, blend, buzz, quiet (RGB565)
} c8_game_t;
#include "games.h"

#define W 1024
#define H 600
// game display area (768x384 = 64x32 * 12 = 128x64 * 6)
#define GX 6
#define GY 6
#define GW 768
#define GH 384
#define BORDER 4
// keypad (right column) and buttons below it
#define KX 786
#define KY 2
#define KW 54
#define KH 92
#define KGAP 6
#define BX 786
#define BY 404
#define BW 114
#define BH 90
// info panel below the display
#define IX 8
#define IY 404

// menu grid
#define MCOLS 3
#define MROWS 4
#define PER_PAGE (MCOLS * MROWS)
#define CARD_W 312
#define CARD_H 100
#define CARD_X0 24
#define CARD_Y0 84
#define CARD_GX 20
#define CARD_GY 12

#define C_BG     0x10A3   // NV_RGB(20, 22, 28)
#define C_CARD   0x2146   // NV_RGB(36, 40, 50)
#define C_KEY    0x31A8   // NV_RGB(48, 52, 64)
#define C_KEYHI  0x5B4F
#define C_TEXT   0xFFFF
#define C_DIM    0x9CF3
#define C_ACCENT 0xFE60   // Octo yellow
#define C_BTN    0x2A09
#define C_RED    0xF9E7

enum { MODE_MENU, MODE_GAME };

static chip8_t  g_c8;
static uint16_t g_band[GW * 12];           // one scaled display row
static uint8_t  g_shown[128 * 128];        // colour index last blitted per view pixel (0xFF = unknown)
static int16_t  g_pcm[256];

static int g_mode, g_page, g_game;
static int g_redraw;                       // full-screen repaint pending
static int g_speed = 2;                    // index into k_speed
static const int k_speed[5] = {25, 50, 100, 200, 400};
static int g_vw, g_vh, g_scale, g_ox, g_oy, g_hires_shown = -1;
static uint16_t g_pal[4], g_dim[4];
static uint16_t g_hint;                    // keys highlighted on the keypad
static uint32_t g_keyvis[16];              // last drawn state per key
static int g_border_on = -1;
static uint16_t g_padmap[12];              // pad bit index -> key mask
static int g_audio;                        // PCM stream open
static uint32_t g_phase, g_step;           // audio pattern phase (16.16 bits) and step per sample
static int g_last_pitch = -1;
static int g_tone_until;                   // nv_gfx_tone fallback
static int g_status_dirty;
static int g_prev_state = -1;
static int g_acc60;                        // elapsed ms * 60 not yet run as ticks
static int g_last_ms;
static int g_cpu_limited;

// ---- small helpers ------------------------------------------------------------------------------
static int slen(const char *s) { int n = 0; while (s[n]) n++; return n; }
static void scpy(char *d, const char *s, int max) { int i = 0; for (; s[i] && i < max - 1; i++) d[i] = s[i]; d[i] = 0; }
static char *sput(char *d, const char *s) { while (*s) *d++ = *s++; *d = 0; return d; }
static char *uput(char *d, unsigned v) {
    char t[12]; int n = 0;
    do { t[n++] = (char)('0' + v % 10); v /= 10; } while (v);
    while (n) *d++ = t[--n];
    *d = 0;
    return d;
}
static char *hput(char *d, unsigned v, int digits) {
    for (int k = digits - 1; k >= 0; k--) *d++ = "0123456789ABCDEF"[(v >> (4 * k)) & 0xF];
    *d = 0;
    return d;
}
static uint16_t mix565(uint16_t a, uint16_t b, int t /*0..256 weight of b*/) {
    int ar = a >> 11, ag = (a >> 5) & 63, ab = a & 31, br = b >> 11, bg = (b >> 5) & 63, bb = b & 31;
    int r = ar + (((br - ar) * t) >> 8), g = ag + (((bg - ag) * t) >> 8), bl = ab + (((bb - ab) * t) >> 8);
    return (uint16_t)(r << 11 | g << 5 | bl);
}
static int luma(uint16_t c) { return ((c >> 11) * 2 * 30 + ((c >> 5) & 63) * 59 + (c & 31) * 2 * 11) / 100; }
static int in_rect(int x, int y, int rx, int ry, int rw, int rh) { return x >= rx && y >= ry && x < rx + rw && y < ry + rh; }
static void text_c(int cx, int y, const char *s, int col, int scale) { nv_gfx_text(cx - slen(s) * 3 * scale, y, s, col, scale); }

// ---- menu ---------------------------------------------------------------------------------------
static int pages(void) { return (C8_NGAMES + PER_PAGE - 1) / PER_PAGE; }
static const char *k_plat[3] = {"CHIP-8", "SCHIP", "XO-CHIP"};
static const int k_platcol[3] = {0x5E7F, 0x6FEE, 0xF97F};

static void card_pos(int i, int *x, int *y) {
    *x = CARD_X0 + (i % MCOLS) * (CARD_W + CARD_GX);
    *y = CARD_Y0 + (i / MCOLS) * (CARD_H + CARD_GY);
}

static void draw_menu(void) {
    nv_gfx_clear(C_BG);
    nv_gfx_text(CARD_X0, 20, "CHIP-8", C_ACCENT, 5);
    char t[64], *p = t;
    p = uput(p, C8_NGAMES); sput(p, " GAMES FROM THE CHIP-8 ARCHIVE - CC0");
    nv_gfx_text(CARD_X0 + 200, 38, t, C_DIM, 2);
    for (int i = 0; i < PER_PAGE; i++) {
        int gi = g_page * PER_PAGE + i;
        if (gi >= C8_NGAMES) break;
        const c8_game_t *g = &c8_games[gi];
        int x, y;
        card_pos(i, &x, &y);
        nv_gfx_rect(x, y, CARD_W, CARD_H, C_CARD);
        // a little "screen" in the game's own palette
        nv_gfx_rect(x + 10, y + 14, 72, 72, g->col[0]);
        nv_gfx_rect(x + 22, y + 26, 16, 16, g->col[1]);
        nv_gfx_rect(x + 46, y + 40, 24, 12, g->col[1]);
        nv_gfx_rect(x + 30, y + 60, 12, 14, g->col[2] != g->col[0] && g->platform == 2 ? g->col[2] : g->col[1]);
        int tx = x + 94, avail = CARD_W - 94 - 8;
        char title[40];
        int sc = slen(g->title) * 18 <= avail ? 3 : 2;
        scpy(title, g->title, avail / (6 * sc) + 1);
        nv_gfx_text(tx, y + 14, title, C_TEXT, sc);
        char au[40];
        scpy(au, g->author, avail / 12 + 1);
        nv_gfx_text(tx, y + 48, au, C_DIM, 2);
        nv_gfx_text(tx, y + 74, k_plat[g->platform], k_platcol[g->platform], 2);
    }
    // page bar
    int np = pages();
    nv_gfx_rect(CARD_X0, 540, 160, 50, g_page > 0 ? C_BTN : C_CARD);
    text_c(CARD_X0 + 80, 554, "<", g_page > 0 ? C_TEXT : C_DIM, 3);
    nv_gfx_rect(W - CARD_X0 - 160, 540, 160, 50, g_page < np - 1 ? C_BTN : C_CARD);
    text_c(W - CARD_X0 - 80, 554, ">", g_page < np - 1 ? C_TEXT : C_DIM, 3);
    char pg[32]; p = pg;
    p = sput(p, "PAGE "); p = uput(p, (unsigned)g_page + 1); p = sput(p, " / "); uput(p, (unsigned)np);
    text_c(W / 2, 556, pg, C_DIM, 3);
}

// ---- game screen --------------------------------------------------------------------------------
static int key_at_pos(int k, int *x, int *y) {   // hex key k -> keypad cell (CHIP-8 layout)
    static const uint8_t layout[16] = {1, 2, 3, 0xC, 4, 5, 6, 0xD, 7, 8, 9, 0xE, 0xA, 0, 0xB, 0xF};
    for (int i = 0; i < 16; i++) {
        if (layout[i] == k) {
            *x = KX + (i % 4) * (KW + KGAP);
            *y = KY + 2 + (i / 4) * (KH + KGAP);
            return 1;
        }
    }
    return 0;
}

static void draw_key(int k, int down) {
    int x, y;
    key_at_pos(k, &x, &y);
    int hint = (g_hint >> k) & 1;
    uint16_t face = down ? C_ACCENT : hint ? C_KEYHI : C_KEY;
    uint16_t lab = down ? 0x0000 : hint ? C_TEXT : C_DIM;
    nv_gfx_rect(x, y, KW, KH, face);
    nv_gfx_rect(x, y + KH - 4, KW, 4, mix565(face, 0, 90));
    if (hint && !down) nv_gfx_rect(x, y, KW, 4, C_ACCENT);
    char s[2] = {"0123456789ABCDEF"[k], 0};
    nv_gfx_text(x + KW / 2 - 12, y + KH / 2 - 14, s, lab, 4);
}

static void draw_buttons(void) {
    static const char *lab[4] = {"MENU", "RESET", "SLOWER", "FASTER"};
    for (int i = 0; i < 4; i++) {
        int x = BX + (i % 2) * (BW + KGAP), y = BY + (i / 2) * (BH + 8);
        nv_gfx_rect(x, y, BW, BH, C_BTN);
        text_c(x + BW / 2, y + BH / 2 - 7, lab[i], C_TEXT, 2);
    }
}

static void draw_info(void) {
    const c8_game_t *g = &c8_games[g_game];
    nv_gfx_rect(0, IY - 2, KX - 4, H - IY + 2, C_BG);
    nv_gfx_text(IX, IY + 4, g->title, C_ACCENT, 3);
    char t[96], *p = t;
    p = sput(p, g->author); p = sput(p, " - "); sput(p, k_plat[g->platform]);
    nv_gfx_text(IX, IY + 36, t, C_DIM, 2);
    // how-to text, word-wrapped at 63 columns (scale 2 = 12 px per char)
    const char *s = g->info;
    int line = 0;
    while (*s && line < 5) {
        int n = slen(s), cut = n;
        if (n > 63) {
            cut = 63;
            while (cut > 0 && s[cut] != ' ') cut--;
            if (cut == 0) cut = 63;
        }
        char buf[64];
        for (int i = 0; i < cut; i++) buf[i] = s[i];
        buf[cut] = 0;
        nv_gfx_text(IX, IY + 66 + line * 20, buf, C_TEXT, 2);
        s += cut;
        while (*s == ' ') s++;
        line++;
    }
    g_status_dirty = 1;
}

static void draw_status(void) {
    const c8_game_t *g = &c8_games[g_game];
    nv_gfx_rect(0, H - 26, KX - 4, 26, C_BG);
    char t[96], *p = t;
    if (g_c8.state == C8_ERROR) {
        p = sput(p, "STOPPED: UNKNOWN OPCODE "); p = hput(p, g_c8.err_op, 4);
        p = sput(p, " AT "); hput(p, g_c8.err_pc, 4);
        nv_gfx_text(IX, H - 22, t, C_RED, 2);
        return;
    }
    if (g_c8.state == C8_HALT) {
        nv_gfx_text(IX, H - 22, "PROGRAM ENDED - RESET OR MENU", C_ACCENT, 2);
        return;
    }
    int ipf = g->tickrate * k_speed[g_speed] / 100;
    if (ipf < 1) ipf = 1;
    p = sput(p, "SPEED "); p = uput(p, (unsigned)k_speed[g_speed]); p = sput(p, "% - ");
    p = uput(p, (unsigned)ipf); p = sput(p, " CYCLES/FRAME");
    if (g_cpu_limited) sput(p, " - CPU LIMIT");
    nv_gfx_text(IX, H - 22, t, C_DIM, 2);
}

static void set_border(int on) {
    if (on == g_border_on) return;
    g_border_on = on;
    const c8_game_t *g = &c8_games[g_game];
    uint16_t c = on ? g->col[4] : g->col[5];
    if (!on && luma(c) < 3) c = 0x0000;
    nv_gfx_rect(GX - BORDER, GY - BORDER, GW + 2 * BORDER, BORDER, c);
    nv_gfx_rect(GX - BORDER, GY + GH, GW + 2 * BORDER, BORDER, c);
    nv_gfx_rect(GX - BORDER, GY, BORDER, GH, c);
    nv_gfx_rect(GX + GW, GY, BORDER, GH, c);
}

static void draw_game_static(void) {
    nv_gfx_clear(C_BG);
    g_border_on = -1;
    set_border(0);
    nv_gfx_rect(GX, GY, GW, GH, c8_games[g_game].col[0]);
    for (int k = 0; k < 16; k++) { draw_key(k, 0); g_keyvis[k] = (uint32_t)(g_hint >> k & 1) << 1; }
    draw_buttons();
    draw_info();
    g_hires_shown = -1;   // forces the display geometry + every row to be re-blitted
}

// View geometry for the current resolution + rotation.
static void geometry(void) {
    const c8_game_t *g = &c8_games[g_game];
    int w = c8_w(&g_c8), h = c8_h(&g_c8);
    int rot = g->rot == 90 || g->rot == 270;
    g_vw = rot ? h : w;
    g_vh = rot ? w : h;
    int sx = GW / g_vw, sy = GH / g_vh;
    g_scale = sx < sy ? sx : sy;
    g_ox = GX + (GW - g_vw * g_scale) / 2;
    g_oy = GY + (GH - g_vh * g_scale) / 2;
    nv_gfx_rect(GX, GY, GW, GH, g_pal[0]);
    for (int i = 0; i < 128 * 128; i++) g_shown[i] = 0xFF;
    g_hires_shown = g_c8.hires;
}

static inline int view_px(int vx, int vy) {
    const chip8_t *c = &g_c8;
    switch (c8_games[g_game].rot) {
    case 90:  return c8_px(c, vy, c8_h(c) - 1 - vx);
    case 180: return c8_px(c, c8_w(c) - 1 - vx, c8_h(c) - 1 - vy);
    case 270: return c8_px(c, c8_w(c) - 1 - vy, vx);
    default:  return c8_px(c, vx, vy);
    }
}

// Blit every view row whose pixels differ from what is on screen.
static void render_display(void) {
    if (g_hires_shown != g_c8.hires) geometry();
    const int s = g_scale, bw = g_vw * s, grid = s >= 4;
    for (int vy = 0; vy < g_vh; vy++) {
        uint8_t *shown = &g_shown[vy * 128];
        int changed = 0;
        for (int vx = 0; vx < g_vw; vx++) {
            uint8_t p = (uint8_t)view_px(vx, vy);
            if (p != shown[vx]) { shown[vx] = p; changed = 1; }
        }
        if (!changed) continue;
        // scale the row: s px per pixel, the last column/line of each cell a shade darker (LCD grid)
        uint16_t *l0 = g_band, *l1 = g_band + bw * (s - 1);
        for (int vx = 0; vx < g_vw; vx++) {
            uint16_t c = g_pal[shown[vx]], d = grid ? g_dim[shown[vx]] : c;
            uint16_t *o = &l0[vx * s], *o1 = &l1[vx * s];
            for (int k = 0; k < s - 1; k++) { o[k] = c; o1[k] = d; }
            o[s - 1] = d; o1[s - 1] = d;
        }
        for (int r = 1; r < s - 1; r++) {
            uint16_t *dst = g_band + r * bw;
            for (int k = 0; k < bw; k++) dst[k] = l0[k];
        }
        nv_gfx_blit(g_band, bw, s, g_ox, g_oy + vy * s);
    }
    g_c8.dirty = 0;
}

// ---- input --------------------------------------------------------------------------------------
static int count_bits(unsigned m) { int n = 0; while (m) { n += m & 1; m >>= 1; } return n; }

// Gamepad: D-pad -> the game's direction keys, A/B/X/Y/L/R/START -> the other keys it uses.
static void build_padmap(void) {
    const c8_game_t *g = &c8_games[g_game];
    uint16_t h = g_hint;
    int up = 5, down = 8, left = 7, right = 9;
    if (count_bits(h & 0x03A0) < 2 && count_bits(h & 0x0154) >= 2) { up = 2; down = 8; left = 4; right = 6; }
    for (int i = 0; i < 12; i++) g_padmap[i] = 0;
    g_padmap[0] = (uint16_t)(1 << up);    // NV_PAD_UP
    g_padmap[1] = (uint16_t)(1 << down);
    g_padmap[2] = (uint16_t)(1 << left);
    g_padmap[3] = (uint16_t)(1 << right);
    uint16_t used = (uint16_t)(1 << up | 1 << down | 1 << left | 1 << right);
    static const uint8_t pref[16] = {6, 4, 0xE, 0xD, 5, 1, 2, 3, 0xA, 0xB, 0xC, 0xF, 0, 7, 8, 9};
    // A, B, X, Y, L, R get the remaining hinted keys (the preferred action keys first)
    static const uint8_t slots[6] = {4, 5, 6, 7, 8, 9};
    int si = 0;
    for (int i = 0; i < 16 && si < 6; i++) {
        int k = pref[i];
        if ((h >> k & 1) && !(used >> k & 1)) { g_padmap[slots[si++]] = (uint16_t)(1 << k); used |= (uint16_t)(1 << k); }
    }
    if (!g_padmap[4]) g_padmap[4] = 1 << 6;   // A defaults to Octo's action key 6
    if (!g_padmap[5]) g_padmap[5] = 1 << 4;
    g_padmap[10] = (uint16_t)(g->start != 0xFF ? 1 << g->start : g_padmap[4]);   // START
    g_padmap[11] = g_padmap[10];                                                 // SELECT
}

static uint16_t read_keys(void) {
    uint16_t m = 0;
    int n = nv_touch_count();
    for (int i = 0; i < n; i++) {
        int x, y;
        if (!nv_touch_at(i, &x, &y)) continue;
        if (x < KX - KGAP / 2 || y >= KY + 4 * (KH + KGAP)) continue;
        int col = (x - KX + KGAP / 2) / (KW + KGAP), row = (y - KY) / (KH + KGAP);
        if (col < 0 || col > 3 || row < 0 || row > 3) continue;
        static const uint8_t layout[16] = {1, 2, 3, 0xC, 4, 5, 6, 0xD, 7, 8, 9, 0xE, 0xA, 0, 0xB, 0xF};
        m |= (uint16_t)(1 << layout[row * 4 + col]);
    }
    int32_t pad = nv_gfx_pad();
    for (int b = 0; b < 12; b++) if (pad & (1 << b)) m |= g_padmap[b];
    if (nv_pad_count() > 0) {
        nv_pad_state_t st;
        if (nv_pad_state(0, &st, sizeof st) > 0) {
            const int dz = 14000;
            if (st.ly < -dz) m |= g_padmap[0];
            if (st.ly > dz) m |= g_padmap[1];
            if (st.lx < -dz) m |= g_padmap[2];
            if (st.lx > dz) m |= g_padmap[3];
        }
    }
    return m;
}

// ---- sound --------------------------------------------------------------------------------------
static void set_pitch(int pitch) {
    // playback rate = 4000 * 2^((pitch - 64) / 48) bits per second; step in 16.16 bits per sample
    float r = 4000.0f;
    int e = pitch - 64;
    const float k = 1.0145453349375237f;   // 2^(1/48)
    while (e > 0) { r *= k; e--; }
    while (e < 0) { r /= k; e++; }
    g_step = (uint32_t)(r * 65536.0f / 16000.0f);
    g_last_pitch = pitch;
}

static void pump_audio(void) {
    const chip8_t *c = &g_c8;
    if (c->pitch != g_last_pitch) set_pitch(c->pitch);
    if (!g_audio) {   // speaker busy: a plain beep at the pattern's rate / 8
        if (c->st > 0) {
            int now = nv_millis();
            if (now >= g_tone_until - 20) {
                int ms = c->st * 1000 / 60;
                int hz = c->pattern_set ? (int)((uint64_t)g_step * 16000u / 65536u / 8u) : 500;
                nv_gfx_tone(hz < 60 ? 60 : hz > 4000 ? 4000 : hz, ms);
                g_tone_until = now + ms;
            }
        }
        return;
    }
    static const uint8_t k_square[16] = {0xF0, 0xF0, 0xF0, 0xF0, 0xF0, 0xF0, 0xF0, 0xF0,
                                         0xF0, 0xF0, 0xF0, 0xF0, 0xF0, 0xF0, 0xF0, 0xF0};
    const uint8_t *pat = c->pattern_set ? c->pattern : k_square;
    int guard = 4;
    while (guard-- > 0 && nv_audio_backlog() < 1536) {
        for (int i = 0; i < 256; i++) {
            int16_t s = 0;
            if (c->st > 0) {
                unsigned bit = (g_phase >> 16) & 127;
                s = (pat[bit >> 3] >> (7 - (bit & 7))) & 1 ? 3500 : -3500;
                g_phase += g_step;
            }
            g_pcm[i] = s;
        }
        if (nv_audio_write(g_pcm, sizeof g_pcm) < 0) { g_audio = 0; return; }
    }
}

// ---- game lifecycle -----------------------------------------------------------------------------
static void start_game(int gi) {
    const c8_game_t *g = &c8_games[gi];
    g_game = gi;
    g_c8.rng = (uint32_t)nv_rand() | 1u;
    c8_reset(&g_c8, &c8_roms[g->off], g->len, g->quirks);
    for (int i = 0; i < 4; i++) g_pal[i] = g->col[i];
    for (int i = 0; i < 4; i++) g_dim[i] = mix565(g->col[i], g->col[0], luma(g->col[i]) > luma(g->col[0]) ? 70 : 40);
    g_hint = g->keys;
    build_padmap();
    g_mode = MODE_GAME;
    g_prev_state = -1;
    g_cpu_limited = 0;
    g_acc60 = 0;
    g_last_ms = nv_millis();
    g_last_pitch = -1;
    g_phase = 0;
    if (!g_audio) g_audio = nv_audio_open(16000, 1) == 1;
    draw_game_static();
}

static void stop_game(void) {
    if (g_audio) { nv_audio_close(); g_audio = 0; }
    g_mode = MODE_MENU;
    g_redraw = 1;
    uint8_t s[2] = {(uint8_t)g_page, (uint8_t)g_speed};
    nv_save("state.bin", s, 2);
}

static void step_game(void) {
    const c8_game_t *g = &c8_games[g_game];
    c8_keys(&g_c8, read_keys());
    // 60 Hz ticks from the wall clock; at most 3 per loop so a slow frame never snowballs
    int now = nv_millis();
    g_acc60 += (now - g_last_ms) * 60;
    g_last_ms = now;
    if (g_acc60 > 3000) g_acc60 = 3000;
    int ipf = g->tickrate * k_speed[g_speed] / 100;
    if (ipf < 1) ipf = 1;
    int limited = 0;
    while (g_acc60 >= 1000) {
        g_acc60 -= 1000;
        // run in slices and give up the rest of a tick after 14 ms (a 10000-cycle game on a slow
        // interpreter plays in slow motion rather than freezing the UI)
        int t0 = nv_millis(), left = ipf;
        while (left > 0 && g_c8.state == C8_RUN && !g_c8.vblank_hit) {
            int n = left < 500 ? left : 500;
            c8_run(&g_c8, n);
            left -= n;
            if (left > 0 && nv_millis() - t0 > 14) { limited = 1; break; }
        }
        c8_tick(&g_c8);
    }
    if (limited != g_cpu_limited) { g_cpu_limited = limited; g_status_dirty = 1; }
    if (g_c8.state != g_prev_state) { g_prev_state = g_c8.state; g_status_dirty = 1; }
    pump_audio();
    if (g_c8.dirty || g_hires_shown != g_c8.hires) render_display();
    set_border(g_c8.st > 0);
    // keypad: pressed keys + hints (games without a how-to learn them from the keys they test)
    if (!g->keys) g_hint |= g_c8.polled;
    for (int k = 0; k < 16; k++) {
        uint32_t vis = (uint32_t)((g_c8.keys >> k & 1) | (g_hint >> k & 1) << 1);
        if (vis != g_keyvis[k]) { g_keyvis[k] = vis; draw_key(k, (int)(vis & 1)); }
    }
    if (g_status_dirty) { g_status_dirty = 0; draw_status(); }
}

#ifdef NV_SIM
int sim_pick(void);   // PC harness: game to launch from the menu (-1 = none)
#endif

NV_EXPORT("run")
void run(void) {
    nv_gfx_persist(1);
    uint8_t s[2];
    if (nv_load("state.bin", s, 2) == 2) {
        g_page = s[0] < pages() ? s[0] : 0;
        g_speed = s[1] < 5 ? s[1] : 2;
    }
    g_mode = MODE_MENU;
    g_redraw = 1;
    int prev_down = 0, sx = 0, sy = 0, lx = 0, ly = 0;
    while (nv_gfx_present()) {
        int back = nv_gfx_back();
        int x, y, down = nv_touch(&x, &y);
        if (down) { lx = x; ly = y; }
        int pressed = down && !prev_down, released = !down && prev_down;
        prev_down = down;
        if (pressed) { sx = x; sy = y; }
        if (g_mode == MODE_MENU) {
            if (back) break;
#ifdef NV_SIM
            int pick = sim_pick();
            if (pick >= 0) { start_game(pick); continue; }
#endif
            if (released) {
                int dx = lx - sx, dy = ly - sy;
                int np = pages();
                if (dx > 120 && (dy < 80 && dy > -80)) { if (g_page > 0) { g_page--; g_redraw = 1; } }
                else if (dx < -120 && (dy < 80 && dy > -80)) { if (g_page < np - 1) { g_page++; g_redraw = 1; } }
                else if (dx < 30 && dx > -30 && dy < 30 && dy > -30) {
                    if (in_rect(sx, sy, CARD_X0, 530, 180, 70)) { if (g_page > 0) { g_page--; g_redraw = 1; } }
                    else if (in_rect(sx, sy, W - CARD_X0 - 180, 530, 180, 70)) { if (g_page < np - 1) { g_page++; g_redraw = 1; } }
                    else {
                        for (int i = 0; i < PER_PAGE; i++) {
                            int gi = g_page * PER_PAGE + i, cx, cy;
                            if (gi >= C8_NGAMES) break;
                            card_pos(i, &cx, &cy);
                            if (in_rect(sx, sy, cx, cy, CARD_W, CARD_H) && in_rect(lx, ly, cx, cy, CARD_W, CARD_H)) {
                                start_game(gi);
                                break;
                            }
                        }
                    }
                }
            }
            if (g_mode == MODE_MENU && g_redraw) { g_redraw = 0; draw_menu(); }
        } else {
            if (back) { stop_game(); draw_menu(); g_redraw = 0; continue; }
            if (released && in_rect(sx, sy, BX, BY, 2 * BW + KGAP, 2 * BH + 8)) {
                int col = (sx - BX) / (BW + KGAP), row = (sy - BY) / (BH + 8);
                int b = row * 2 + col;
                if (in_rect(lx, ly, BX + col * (BW + KGAP), BY + row * (BH + 8), BW, BH)) {
                    if (b == 0) { stop_game(); draw_menu(); g_redraw = 0; continue; }
                    if (b == 1) { start_game(g_game); continue; }
                    if (b == 2 && g_speed > 0) { g_speed--; g_status_dirty = 1; }
                    if (b == 3 && g_speed < 4) { g_speed++; g_status_dirty = 1; }
                }
            }
            step_game();
        }
    }
    if (g_audio) nv_audio_close();
}
