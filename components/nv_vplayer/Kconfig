## components/nv_vplayer/Kconfig
```kconfig
menu "NucleoOS video player (nv_vplayer)"

    config NV_VPLAYER_H264
        bool "Software H.264 / MP4 playback path (esp_h264 SW decoder)"
        default n
        help
            Compiles the .mp4/.h264 playback path (esp_h264 software decoder + AAC audio
            task). It is NOT part of the supported format set (MJPEG-AVI and MPEG-1 are):
            the I420/PPA render path has hung on hardware and never passed verification.
            Leaving it off drops libtinyh264 from the link — about 22 KB of internal SRAM
            (IRAM-placed decoder code), ~85 KB of flash and a 516 KB PSRAM assembly buffer
            per open. The camera's H.264 HW ENCODER is unaffected (separate esp_h264 part).

endmenu
```

## components/nv_wake/Kconfig
```kconfig
menu "NucleoOS wake word"

config NV_WAKE_ESP_SR
    bool "Hands-free ANIMA: wake word with ESP-SR WakeNet"
    default n
    help
        Listens for a wake word fully offline (ESP-SR WakeNet) and then takes the spoken question.
        Needs the ESP-SR component and its models in the "model" flash partition:

          cd components/nv_wake && idf.py add-dependency "espressif/esp-sr^2.1"
          idf.py menuconfig   (ESP Speech Recognition > Load Multiple Wake Words: pick one or more)
          idf.py build flash  (ESP-SR flashes srmodels.bin into the "model" partition)

        Off: the feature compiles out and Settings explain it is not in this build.

endmenu
```
